## src/ble/Kconfig
```kconfig
config APP_BLE_CORE
	bool "Bluetooth core (enable stack, connection & security handling)"
	default y
	depends on BT
	help
	  Brings up the Bluetooth stack and provides shared connection and
	  security callbacks used by the Channel Sounding modules.

config APP_ADV
	bool "Role-independent connectable advertising"
	default y
	depends on BT_PERIPHERAL && APP_CS
	help
	  Owns the single connectable advertiser so the tag is discoverable for
	  the phone-facing services (ESS/Motion/SMP) whenever idle or acting as a
	  reflector, not only during CS ranging.
```

## src/control/Kconfig
```kconfig
config APP_CONTROL
	bool "Runtime control shell (cs role/mode/start/stop)"
	default y
	depends on SHELL
	help
	  Registers shell commands to select the Channel Sounding role and
	  ranging mode and to start/stop ranging at runtime.
```

## src/cs/Kconfig
```kconfig
config APP_CS
	bool "Channel Sounding (dual-role, RAS + inline-PCT)"
	default y
	depends on BT_CHANNEL_SOUNDING
	help
	  Bluetooth Channel Sounding demo supporting both initiator and
	  reflector roles and both RAS (GATT Ranging Service) and inline-PCT
	  (IPT) transports, switchable at runtime.

if APP_CS

choice APP_CS_DEFAULT_ROLE
	prompt "Default CS role at boot"
	default APP_CS_DEFAULT_ROLE_REFLECTOR

config APP_CS_DEFAULT_ROLE_INITIATOR
	bool "Initiator (central, computes distance)"

config APP_CS_DEFAULT_ROLE_REFLECTOR
	bool "Reflector (peripheral, being located)"

endchoice

choice APP_CS_DEFAULT_MODE
	prompt "Default CS ranging mode at boot"
	default APP_CS_DEFAULT_MODE_IPT

config APP_CS_DEFAULT_MODE_RAS
	bool "RAS (GATT Ranging Service transfer)"

config APP_CS_DEFAULT_MODE_IPT
	bool "IPT (inline PCT, local estimation)"

endchoice

config APP_CS_AUTOSTART
	bool "Start Channel Sounding automatically at boot"
	default n if APP_UX
	default y
	help
	  Start ranging with the default role/mode at boot, without waiting
	  for a `cs start` shell command. Disable to require manual start.

config APP_CS_DISTANCE_OFFSET_MM
	int "Static distance calibration offset (mm), added to every estimate"
	default -914
	range -10000 10000
	help
	  Fixed RF/antenna-path bias correction added to each distance estimate
	  before it is logged/reported. Default -914 mm (approx -3 ft) cancels
	  the ~1 m bias two adjacent tags report. The corrected value is clamped
	  to be non-negative.

config APP_CS_STABILIZE
	bool "Accelerometer-assisted distance stabilization"
	default y
	depends on APP_SENSORS
	help
	  Use the initiator's accelerometer (sensors_is_stationary) to adapt the
	  distance filter: when stationary, use the full median window and reject
	  physically-impossible jumps; when moving, use a short window to track.

if APP_CS_STABILIZE

config APP_CS_STAB_GATE_MM
	int "Stationary outlier-rejection gate (mm)"
	default 1000
	help
	  While stationary, a new estimate deviating from the current median by
	  more than this is treated as a spike and dropped.

config APP_CS_STAB_WINDOW_MOVING
	int "Median window size while moving (samples)"
	default 3
	range 1 9
	help
	  Smaller window = more responsive while moving. Stationary always uses
	  the full window.

endif # APP_CS_STABILIZE

endif # APP_CS
```

## src/ess/Kconfig
```kconfig
config APP_ESS
	bool "Environmental Sensing Service (SIG, 0x181A)"
	default y
	depends on BT_PERIPHERAL
	help
	  Expose the BME688 temperature, humidity and pressure over the
	  Bluetooth SIG Environmental Sensing Service (read + notify).

if APP_ESS

config APP_ESS_NOTIFY_INTERVAL_MS
	int "ESS notification interval (ms)"
	default 1000
	range 100 60000
	help
	  Period at which subscribed ESS characteristics are notified.

endif # APP_ESS
```

## src/motion/Kconfig
```kconfig
config APP_MOTION
	bool "Custom BLE Motion Service (accel + gyro streaming)"
	default y
	depends on BT_PERIPHERAL
	help
	  Custom 128-bit GATT service streaming high-rate accelerometer and
	  gyroscope samples via notifications, draining the IMU stream queue.

if APP_MOTION

config APP_MOTION_CONN_INTERVAL_MIN
	int "Requested min connection interval (1.25 ms units)"
	default 6
	range 6 3200
	help
	  Requested on subscribe via bt_conn_le_param_update. 6 = 7.5 ms
	  (BLE standard minimum). Sub-7.5 ms requires controller/central support.

config APP_MOTION_CONN_INTERVAL_MAX
	int "Requested max connection interval (1.25 ms units)"
	default 6
	range 6 3200

endif # APP_MOTION
```

## src/sensors/Kconfig
```kconfig
config APP_SENSORS
	bool "Onboard sensor sampling (BME688, ADXL367, BMI270)"
	default y
	depends on SENSOR
	help
	  Periodically sample the onboard environmental sensor, accelerometer
	  and IMU and log the readings.

if APP_SENSORS

config APP_SENSORS_SAMPLE_INTERVAL_MS
	int "Sensor sample interval (ms)"
	default 1000
	range 50 60000
	help
	  Period between sensor sampling passes.

config APP_SENSORS_STATIONARY_RATE_HZ
	int "Stationarity monitor sample rate (Hz)"
	default 25
	range 1 200
	help
	  Rate at which the ADXL367 is polled to detect motion for
	  sensors_is_stationary().

config APP_SENSORS_STATIONARY_WINDOW
	int "Stationarity variance window (samples)"
	default 25
	range 4 128
	help
	  Number of recent accel-magnitude samples used for the variance test.

config APP_SENSORS_STATIONARY_THRESH_MMS2
	int "Stationarity threshold (milli-m/s^2 std-dev)"
	default 300
	help
	  Below this accel-magnitude standard deviation the tag is considered
	  stationary. 300 = 0.3 m/s^2.

endif # APP_SENSORS
```

## src/ux/Kconfig
```kconfig
config APP_UX
	bool "Button + RGB-LED UX for the two-tag CS demo"
	default y
	depends on APP_CS && DK_LIBRARY
	help
	  Button cycles the Channel Sounding role (Off/Reflector/Initiator) and
	  the RGB LED shows the role and, once the initiator is ranging, the
	  distance (color zone + blink rate).

if APP_UX

config APP_UX_SHORT_DEMO
	bool "Short-distance demo LED mapping (1-3 ft)"
	default n
	help
	  Remap the LED distance zones to a 1-3 ft span (green <1 ft, yellow
	  1-3 ft, red beyond) for close-range demos, instead of the default
	  multi-meter mapping. Also tightens the blink range so movement within
	  1-3 ft is visibly reactive (the blink period is interpolated across the
	  near..far span).

config APP_UX_NEAR_MM
	int "Near/mid distance threshold (mm)"
	default 305 if APP_UX_SHORT_DEMO
	default 1000
	help
	  Distance below this shows green.

config APP_UX_FAR_MM
	int "Mid/far distance threshold (mm)"
	default 914 if APP_UX_SHORT_DEMO
	default 3000
	help
	  Distance below this shows yellow; at or above, red.

config APP_UX_BLINK_FAST_MS
	int "Blink period at contact (ms, fastest)"
	default 120
	help
	  Blink period when the tags are touching (distance 0). The period is
	  interpolated up to APP_UX_BLINK_SLOW_MS at the far threshold, so closer
	  blinks faster.

config APP_UX_BLINK_SLOW_MS
	int "Blink period at/after the far threshold (ms, slowest)"
	default 1200
	help
	  Blink period at (and beyond) APP_UX_FAR_MM.

endif # APP_UX
```

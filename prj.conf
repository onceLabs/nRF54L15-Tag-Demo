## CMakeLists.txt
```
#
# nRF54L15 Tag Demo
#
cmake_minimum_required(VERSION 3.20.0)
find_package(Zephyr REQUIRED HINTS $ENV{ZEPHYR_BASE})

project(nRF54L15TagDemo)

# main.c lives at the top level; each functional area is a self-contained
# module under src/ with its own CMakeLists.txt and Kconfig.
target_sources(app PRIVATE src/main.c)

add_subdirectory(src/sensors)
add_subdirectory(src/ble)
add_subdirectory(src/cs)
add_subdirectory(src/ess)
add_subdirectory(src/motion)
add_subdirectory(src/ux)
add_subdirectory(src/control)
```

## Kconfig
```
# nRF54L15 Tag Demo application configuration

menu "Tag Demo"

rsource "src/sensors/Kconfig"
rsource "src/ble/Kconfig"
rsource "src/cs/Kconfig"
rsource "src/ess/Kconfig"
rsource "src/motion/Kconfig"
rsource "src/ux/Kconfig"
rsource "src/control/Kconfig"

endmenu

source "Kconfig.zephyr"
```

## west.yml
```
# West manifest — nRF54L15 Tag Demo (T2 topology: this repo is the manifest repo).
#
# Bootstrap a workspace with:
#   west init -m https://github.com/onceLabs/nRF54L15-Tag-Demo --mr main <ws>
#   cd <ws> && west update --narrow -o=--depth=1
#
# The import allow-list pulls only the nRF Connect SDK modules this application
# builds against (derived from the app's compile_commands.json), excluding the
# large unused stacks (Matter, LVGL, TF-M, OpenThread, Wi-Fi, LoRaMAC, ...).
manifest:
  version: "1.0"

  remotes:
    - name: nrfconnect
      url-base: https://github.com/nrfconnect

  projects:
    - name: sdk-nrf
      remote: nrfconnect
      repo-path: sdk-nrf
      revision: v3.4.0
      path: nrf              # NCS build glue expects the SDK tree at nrf/
      import:
        name-allowlist:
          - zephyr             # core RTOS
          - nrfxlib            # SoftDevice Controller + MPSL + crypto libs
          - hal_nordic         # nrfx + MDK (nRF54L15)
          - cmsis              # CMSIS core
          - cmsis_6            # CMSIS 6
          - cmsis-dsp          # FFT/DSP used by cs_de
          - mbedtls            # nrf_security backend
          - oberon-psa-crypto  # PSA crypto (BLE SMP / MCUmgr)
          - tf-psa-crypto      # NCS 3.4 PSA crypto integration
          - picolibc           # C library
          - segger             # RTT (console / log / shell)
          - zcbor              # MCUmgr / SMP encoding

  self:
    path: nRF54L15TagDemo
```

## prj.conf
```kconfig
# ============================================================================
# nRF54L15 Tag Demo — dual-role, dual-mode (RAS + inline-PCT) Channel Sounding
#                     plus onboard sensors (BME688, ADXL367, BMI270).
# ============================================================================

CONFIG_NCS_SAMPLES_DEFAULTS=y
CONFIG_DK_LIBRARY=y

# --- Bluetooth: dual-role (initiator = central, reflector = peripheral) ------
CONFIG_BT=y
CONFIG_BT_SMP=y
CONFIG_BT_PERIPHERAL=y
CONFIG_BT_CENTRAL=y
# Two simultaneous links: outbound central (CS reflector) + inbound peripheral
# (screen / phone / SMP host). The initiator advertises for a host while ranging.
CONFIG_BT_MAX_CONN=2
CONFIG_BT_MAX_PAIRED=2
CONFIG_BT_BONDABLE=n
CONFIG_BT_DEVICE_NAME="nRF54L15 Tag"

CONFIG_BT_GATT_CLIENT=y
CONFIG_BT_GATT_DYNAMIC_DB=y

# --- Channel Sounding -------------------------------------------------------
CONFIG_BT_CHANNEL_SOUNDING=y
CONFIG_BT_CTLR_CHANNEL_SOUNDING_TEST=n
CONFIG_BT_CTLR_EXTENDED_FEAT_SET=y     # required for inline-PCT (IPT); harmless for RAS
CONFIG_BT_TRANSMIT_POWER_CONTROL=y

# --- RAS: both Requestor (initiator) and Responder (reflector) --------------
CONFIG_BT_RAS=y
CONFIG_BT_RAS_RREQ=y
CONFIG_BT_RAS_RRSP=y
CONFIG_BT_RAS_MODE_3_SUPPORTED=n

# --- Distance estimation library (shared by RAS + IPT) ----------------------
CONFIG_BT_CS_DE=y
CONFIG_BT_CS_DE_1024_NFFT=y
CONFIG_FPU=y
CONFIG_FPU_SHARING=y
CONFIG_CBPRINTF_FP_SUPPORT=y

# --- Scanning: UUID filter for RAS, name filter for IPT ---------------------
CONFIG_BT_SCAN=y
CONFIG_BT_SCAN_FILTER_ENABLE=y
CONFIG_BT_SCAN_UUID_CNT=1
CONFIG_BT_SCAN_NAME_CNT=1

# --- Larger MTU/buffers (RAS Ranging Profile recommends >= 247-octet MTU) ---
CONFIG_BT_L2CAP_TX_MTU=498
CONFIG_BT_BUF_ACL_TX_SIZE=502
CONFIG_BT_BUF_ACL_RX_SIZE=502
CONFIG_BT_ATT_PREPARE_COUNT=3
CONFIG_BT_CTLR_DATA_LENGTH_MAX=251
CONFIG_BT_CTLR_PHY_2M=y

# --- Extra TX buffering for sustained high-rate motion notifications --------
CONFIG_BT_ATT_TX_COUNT=8
CONFIG_BT_L2CAP_TX_BUF_COUNT=8
CONFIG_BT_BUF_ACL_TX_COUNT=8
CONFIG_BT_CONN_TX_MAX=8

# --- Shorter Connection Intervals (SCI): sub-7.5 ms on the tag<->tag link ---
# Requires Extended Feature Set (above) + Subrating + Frame Space Update.
CONFIG_BT_LE_EXTENDED_FEAT_SET=y
CONFIG_BT_SUBRATING=y
CONFIG_BT_FRAME_SPACE_UPDATE=y
CONFIG_BT_SHORTER_CONNECTION_INTERVALS=y
# Connection-event length must be shorter than the (sub-7.5 ms) interval.
CONFIG_BT_CTLR_SDC_MAX_CONN_EVENT_LEN_DEFAULT=750
# Don't let the host auto-update conn params and fight the SCI rate.
CONFIG_BT_GAP_AUTO_UPDATE_CONN_PARAMS=n

# Do NOT set BT_CTLR_SDC_CS_ROLE_*_ONLY — dual-role needs both roles.

# --- Sensors ----------------------------------------------------------------
CONFIG_SENSOR=y

# --- Logging + shell (over RTT; build with `-S rtt-console`) ----------------
# This board has no UART, so bind the shell to the SEGGER RTT backend
# (the default serial backend has no console device to attach to).
CONFIG_LOG=y
# Deferred (full) log mode — the default minimal mode supports neither runtime
# filtering nor the `log` shell command.
CONFIG_LOG_MODE_DEFERRED=y
# Runtime filtering + the `log` shell command give whole-module log control
# (`log enable/disable <lvl> <module>` for app_ble_core, app_cs, ...).
CONFIG_LOG_RUNTIME_FILTERING=y
CONFIG_LOG_CMDS=y
CONFIG_SHELL=y
CONFIG_SHELL_BACKEND_SERIAL=n
CONFIG_SHELL_BACKEND_RTT=y
# Dummy shell backend: required by the MCUmgr shell management group below
# (it runs shell commands and captures their output). Coexists with RTT.
CONFIG_SHELL_BACKEND_DUMMY=y

# --- MCUmgr / SMP over Bluetooth (remote shell + management) ----------------
# Exposes the cs/sensor/log shell commands over BLE (mcumgr / nRF Connect
# Device Manager). The SMP-BT GATT service auto-registers at boot.
# MCUMGR depends on (does not select) NET_BUF + ZCBOR; NET_BUF comes from BT.
CONFIG_ZCBOR=y
CONFIG_MCUMGR=y
CONFIG_MCUMGR_TRANSPORT_BT=y
CONFIG_MCUMGR_TRANSPORT_BT_REASSEMBLY=y
CONFIG_MCUMGR_TRANSPORT_BT_CONN_PARAM_CONTROL=y
CONFIG_MCUMGR_GRP_SHELL=y
CONFIG_MCUMGR_GRP_OS=y
# SMP service permission: open (no encryption/auth). The default for BT_SMP is
# ..._PERM_RW_AUTHEN, which requires an authenticated (MITM/L3) link — unreachable
# on this NoInputNoOutput device (no pairing/IO-capability callbacks), so every SMP
# access would fail with "insufficient authentication". Open lets a screen/host use
# SMP with no pairing (acceptable for a demo).
CONFIG_MCUMGR_TRANSPORT_BT_PERM_RW=y


# Enable shorter distance demo
CONFIG_APP_UX_SHORT_DEMO=y
```

## boards/nrf54l15tag_nrf54l15_cpuapp.conf
```kconfig
#
# nRF54L15 Tag: use the additional onboard antennas for Channel Sounding.
#
CONFIG_BT_CS_DE_MAX_NUM_ANTENNA_PATHS=4
CONFIG_BT_CTLR_SDC_CS_MAX_ANTENNA_PATHS=4
CONFIG_BT_CTLR_SDC_CS_NUM_ANTENNAS=2
```

## boards/nrf54l15tag_nrf54l15_cpuapp.overlay
```dts
/*
 * nRF54L15 Tag application overlay.
 *
 *  - Replaces the fixed SKY13348 antenna hog with the Channel Sounding
 *    antenna-switch driver so the controller can steer the 2 antennas.
 *  - Adds sensor aliases used by the sensor module.
 */

/ {
	cs_antenna_switch: cs-antenna-config {
		status = "okay";
		compatible = "nordic,bt-cs-antenna-switch";
		ant-gpios = <&gpio1 9 GPIO_ACTIVE_HIGH>,
			    <&gpio1 10 GPIO_ACTIVE_HIGH>;
		multiplexing-mode = <0>;
	};

	aliases {
		accel0 = &adxl367;
		env0   = &bme688;
		imu0   = &bmi270;
	};
};

/* Remove the node that statically drives the antenna pins so there is no
 * duplicate access with the CS antenna switch above.
 */
/delete-node/ &sky13348;

&gpio1 {
	/delete-node/ antenna_switch_v1;
	/delete-node/ antenna_switch_v2;
};
```

## src/main.c
```c
/*
 * Copyright (c) 2026 onceLabs
 *
 * SPDX-License-Identifier: BSD-3-Clause
 */
/*
 * nRF54L15 Tag Demo
 *
 * Dual-role, dual-mode (RAS + inline-PCT) Bluetooth Channel Sounding plus
 * onboard sensor sampling. Functional areas live in self-contained modules
 * under src/; each is enabled by its own CONFIG_APP_* symbol.
 */
#include <zephyr/kernel.h>
#include <zephyr/logging/log.h>

#include "sensors/sensors.h"
#include "ble/ble_core.h"
#include "ble/adv.h"
#include "cs/cs_shared.h"
#include "ess/ess.h"
#include "motion/motion.h"
#include "ux/ux.h"

LOG_MODULE_REGISTER(main, CONFIG_LOG_DEFAULT_LEVEL);

int main(void)
{
	int err;

	LOG_INF("nRF54L15 Tag Demo starting");

	err = sensors_init();
	if (err) {
		LOG_ERR("sensors_init failed (%d)", err);
	}

	err = ble_core_init();
	if (err) {
		LOG_ERR("ble_core_init failed (%d)", err);
	}

	err = adv_init();
	if (err) {
		LOG_ERR("adv_init failed (%d)", err);
	}

	err = cs_init();
	if (err) {
		LOG_ERR("cs_init failed (%d)", err);
	}

	err = ess_init();
	if (err) {
		LOG_ERR("ess_init failed (%d)", err);
	}

	err = motion_init();
	if (err) {
		LOG_ERR("motion_init failed (%d)", err);
	}

	err = ux_init();
	if (err) {
		LOG_ERR("ux_init failed (%d)", err);
	}

	LOG_INF("nRF54L15 Tag Demo ready");
	return 0;
}
```
